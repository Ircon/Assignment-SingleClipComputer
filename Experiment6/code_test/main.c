/*******************************************************

程序功能：LCD12864液晶测试

开发环境：Keil3

硬件环境：CEPARK多功能开发学习板/实验箱（2013版），STC12C5A60S2，11.0592M晶振
																							   
接线说明：单片机P1口与底板JP41排针相连，分别为：P10-D0, P11-D1，P12-D2，P13-D3，P14-D4，P15-D5，P16-D6，P17-D7；
          单片机P34~P37口与底板JP36相连，分别为：P34-RS,P35-RW,P36-EN，P37-CS1，CS2悬空		

跳线说明：无

实验现象：液晶屏显示图片

									 
论坛支持：http://bbs.cepark.com

淘宝店铺：http://cepark.taobao.com

作者：cepark 

时间：2013-01-01（元旦快乐！）



*******************************************************/



#include <REG52.H>

sbit LCD12864_RS  =  P3^4;	 //RS控制引脚
sbit LCD12864_RW  =  P3^3;	 //RW控制引脚
sbit LCD12864_EN  =  P3^2;	 //EN控制引脚
sbit LCD12864_PSB  =  P3^0;	  //模式选择引脚，ST7920控制器，1为8位并行接口，0为串行接口

#define LCDPORT P1		//数据引脚


void LCD12864_Init(void);		  //LCD12864初始化函数
void LCD12864_WriteInfomation(unsigned char ucData,bit bComOrData);	   
	//向LCD12864写入数据，bComOrData为1时写入的是数据，0时写入的是命令

void LCD12864_CheckBusy(void);		//忙检测函数
void LCD12864_DisplayImage(unsigned char code *ucImage);
void Delay(unsigned int uiCount);

unsigned char code ucPic[]={
			0xFF,0xFF,0xFF,0xFF,0xFF,0xFF,0xFF,0xFF,0xFF,0xFF,0xFF,0xFF,0xFF,0xFF,0xFF,0xFF,
			0x80,0x00,0x00,0x00,0x00,0x00,0x00,0x00,0x00,0x00,0x00,0x00,0x00,0x00,0x00,0x01,
			0x80,0x00,0x00,0x00,0x00,0x00,0x00,0x00,0x00,0x00,0x00,0x00,0x00,0x00,0x00,0x01,
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			0xFF,0xFF,0xFF,0xFF,0xFF,0xFF,0xFF,0xFF,0xFF,0xFF,0xFF,0xFF,0xFF,0xFF,0xFF,0xFF,};//图像数据

/******************************************************************************
函数名称：main
函数功能：主函数，程序如路口
入口参数：无
返回值：无
备注：无
*******************************************************************************/
void main(void)
{
	LCD12864_Init();   //初始化液晶
	
	LCD12864_DisplayImage(ucPic);
	while(1);

}

/******************************************************************************
函数名称：LCD12864_WriteInfomation
函数功能：向LCD12864写入命令或者数据
入口参数：ucData-要写入液晶的数据或者命令的内容
		  bComOrData-命令或者数据的标志位选择，0或者1，其中
		  	1：写入的是数据
			0：写入的是命令
返回值：无
备注：无
*******************************************************************************/
void LCD12864_WriteInfomation(unsigned char ucData,bit bComOrData)
{
	LCD12864_CheckBusy();	//忙检测
	LCD12864_RW = 0;	//拉低RW
	LCD12864_RS = bComOrData;	//根据标志位判断写入的是命令还是数据
	Delay(10);				  //延时，等待操作
	LCDPORT = ucData;		  //将数据送至数据端口
	LCD12864_EN = 1;		  //使能信号
	Delay(10);				  //延时
	LCD12864_EN = 0;		//按照时序来操作
	Delay(10);
}

/******************************************************************************
函数名称：LCD12864_Init
函数功能：LCD12864液晶初始化
入口参数：无
返回值：无
备注：无
*******************************************************************************/
void LCD12864_Init(void)
{
	Delay(400);//延时
	LCD12864_PSB = 1;	//8位并口工作模式
	Delay(150);//延时


	LCD12864_WriteInfomation(0x36,0); //基本指令集
	Delay(150);
	LCD12864_WriteInfomation(0x36,0);  //显示设置
	Delay(150);
	LCD12864_WriteInfomation(0x3E,0);	//光标设置
	Delay(150);
	LCD12864_WriteInfomation(0x0c,0);	//游标设置
	Delay(150);
	LCD12864_WriteInfomation(0x01,0);  //清屏
	Delay(150);
}

/******************************************************************************
函数名称：LCD12864_CheckBusy
函数功能：忙检测
入口参数：无
返回值：无
备注：使用变量i做计时，避免液晶在死循环处停滞。
*******************************************************************************/
void LCD12864_CheckBusy(void)
{
	unsigned char i = 250;	//局部变量
	LCD12864_RS = 0;	  //拉低
	LCD12864_RW = 1;	  //拉高
	LCD12864_EN = 1;	  //使能
	while((i > 0) && (P0 & 0x80))i--;  //判断忙标志位
	LCD12864_EN = 0;	  //释放
}

/******************************************************************************
函数名称：LCD12864_DisplayImage
函数功能：显示一副图像
入口参数：无
返回值：无
备注：无
*******************************************************************************/
void LCD12864_DisplayImage(unsigned char code *ucImage)
{
	unsigned char i,j;
	for(i = 0;i < 32;i++)
	{
		LCD12864_WriteInfomation((0x80 + i),0);
		LCD12864_WriteInfomation(0x80,0);
		for(j = 0;j < 16;j++)
		{
			LCD12864_WriteInfomation(*ucImage,1);
			ucImage++;
		}
	}

	for(i = 0;i < 32;i++)
	{
		LCD12864_WriteInfomation((0x80 + i),0);
		LCD12864_WriteInfomation(0x88,0);
		for(j = 0;j < 16;j++)
		{
			LCD12864_WriteInfomation(*ucImage,1);
			ucImage++;
		}
	}
}

/******************************************************************************
函数名称：Delay
函数功能：延时函数
入口参数：uiCount-延时参数
返回值：无
备注：无
*******************************************************************************/
void Delay(unsigned int uiCount)
{
	while(uiCount--);
}



/****************end of line3**********************/
/****************end of line2**********************/
/****************end of line1**********************/
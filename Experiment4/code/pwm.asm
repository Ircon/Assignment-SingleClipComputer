;分配内存
;栈从 50H 开始
;30h 40h 随便用

; ---- RAM ----
REG_PRE 		DATA 	30H
REG_CNT 		DATA 	31H


; ---- PIN ----
PIN_SOUND 		EQU 	P1.1
PIN_LED 		EQU 	P1.2

PIN_K1			EQU		P0.0
PIN_K2			EQU		P0.1
PIN_K3			EQU		P0.2
PIN_K4			EQU		P0.3
PIN_K5			EQU		P0.4
PIN_K6			EQU		P0.5

; ---- CONST NUMBER ----
COS_TH0_INIT 	EQU		0D8H
COS_TL0_INIT	EQU		0F0H
COS_TMOD		EQU		01H


; ---- CODE ----
ORG 0000H
	LJMP INIT
ORG 000BH
	LJMP T0_INT

ORG 0030H
INIT:
	MOV SP,#50H
	MOV TMOD,#COS_TMOD
	MOV TH0,#COS_TH0_INIT
	MOV TL0,#COS_TL0_INIT
	
	SETB ET0
	SETB EA
	SETB TR0
	
	LCALL DO_SOM_SET
	
	MOV REG_PRE,#5
	
MAIN:
	;FOR TEST
	;LCALL T0_INT
	
	;Search for key
	MOV C,PIN_K1
	JC K2
	MOV REG_PRE,#0
K2:
	MOV C,PIN_K2
	JC K3
	MOV REG_PRE,#2
K3:
	MOV C,PIN_K3
	JC K4
	MOV REG_PRE,#4
K4:
	MOV C,PIN_K4
	JC K5
	MOV REG_PRE,#6
K5:
	MOV C,PIN_K5
	JC K6
	MOV REG_PRE,#8
K6:
	MOV C,PIN_K6
	JC K_END
	MOV REG_PRE,#10
K_END:
	LJMP MAIN

; ---- FUN ----

; CLR BIT
DO_SOM_CLR:
	CLR PIN_SOUND
	CLR PIN_LED
	RET

; SETB BIT
DO_SOM_SET:
	SETB PIN_SOUND
	SETB PIN_LED
	RET

; 100HZ TO CALL
TIMER_CALL:
	
	PUSH ACC
	PUSH PSW
	
	
	MOV A,REG_CNT
	CJNE A,#10,TIMER_PRE
	MOV A,#0
	LCALL DO_SOM_SET
	LJMP TIMER_CALL_END
	
TIMER_PRE:
	JC TIMER_PRE_1
	
	MOV A,#0
	LCALL DO_SOM_SET
	LJMP TIMER_CALL_END
	
TIMER_PRE_1:
	CJNE A,REG_PRE,TIMER_CALL_END
	LCALL DO_SOM_CLR

TIMER_CALL_END:

	INC A
	MOV REG_CNT,A
	POP PSW
	POP ACC
	
	RET
	

; ---- INT FUN ----

; 100HZ to call this in interrupte
T0_INT:
	
	MOV TH0,#COS_TH0_INIT
	MOV TL0,#COS_TL0_INIT
	LCALL TIMER_CALL
	
	RETI

END
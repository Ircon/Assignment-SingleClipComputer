;分配内存
;栈从 50H 开始
;30h 40h 随便用

;----- RAM 分配 ----
REG_SEC				DATA 	30H
REG_MIN				DATA	31H
REG_HOU 			DATA 	32H

REG_LOC_BUFF		DATA	33H
REG_NUM_BUFF		DATA	34H

REG_TIMES			DATA	35H
REG_CNT				DATA	36H

REG_LED_INT			DATA	37H

;---- 常量 ----
COS_SP_BEG	EQU 	50H


;---- Address ----
ADD_R1	EQU		01H
;---- PIN ----
PIN_DS 		EQU P2.2
PIN_SHCP 	EQU P2.1
PIN_STCP 	EQU P2.0


ORG 0000H
	LJMP INIT
ORG 0003H
	LJMP X0_INT
ORG 000BH   
	LJMP T0_INT

ORG 0030H
INIT:
	MOV SP,#COS_SP_BEG
	MOV REG_HOU,#01H
	MOV REG_MIN,#02H
	MOV REG_SEC,#03H
	MOV REG_TIMES,#00H
	MOV REG_CNT,#00H
	MOV REG_LED_INT,#0DFH
	;TIMER
	MOV  TMOD,#01H	;定时器0工作方式1
	MOV  TH0, #60	;赋初值
	MOV  TL0, #176  
	SETB TR0		;启动定时器0
	SETB ET0		;打开定时器0开关
	SETB EX0
	SETB IT0
	SETB EA 		;总开关
	
MAIN:
	; SEC =========
	MOV A,REG_SEC
	CJNE A,#60,MAIN_1
	MOV R1,A
	MOV A,REG_MIN
	INC A
	MOV REG_MIN,A
	MOV A,R1
	
	MOV REG_SEC,#0
	MOV A,#0H
MAIN_1:
	MOV B,#10
	DIV AB
	
	
	MOV REG_LOC_BUFF,#4
	MOV REG_NUM_BUFF,A
	
	LCALL SHOW_NUM_SING
	LCALL DELY_DISY
	
	MOV REG_LOC_BUFF,#5
	MOV REG_NUM_BUFF,B
	
	LCALL SHOW_NUM_SING
	LCALL DELY_DISY

	; MIN ===========
	MOV A,REG_MIN
	CJNE A,#60,MAIN_2
	MOV R1,A
	MOV A,REG_HOU
	INC A
	MOV REG_HOU,A
	MOV A,R1
	
	MOV REG_MIN,#0
	MOV A,#0H
	
MAIN_2:
	MOV B,#10
	DIV AB
	
	MOV REG_LOC_BUFF,#2
	MOV REG_NUM_BUFF,A
	
	LCALL SHOW_NUM_SING
	LCALL DELY_DISY
	
	MOV REG_LOC_BUFF,#3
	MOV REG_NUM_BUFF,B
	
	LCALL SHOW_NUM_SING
	LCALL DELY_DISY
	
	;HOUR ========
	MOV A,REG_HOU
	MOV B,#10
	DIV AB
	
	MOV REG_LOC_BUFF,#0
	MOV REG_NUM_BUFF,A
	
	LCALL SHOW_NUM_SING
	LCALL DELY_DISY
	
	MOV REG_LOC_BUFF,#1
	MOV REG_NUM_BUFF,B
	
	LCALL SHOW_NUM_SING
	LCALL DELY_DISY
	
	; TIMES ======
	MOV A,REG_TIMES
	MOV B,#10
	DIV AB
	
	MOV REG_LOC_BUFF,#6
	MOV REG_NUM_BUFF,A
	
	LCALL SHOW_NUM_SING
	LCALL DELY_DISY
	
	MOV REG_LOC_BUFF,#7
	MOV REG_NUM_BUFF,B
	
	LCALL SHOW_NUM_SING
	LCALL DELY_DISY
	
	LJMP MAIN

;---- 子程序 ----
DELY_DISY:
	PUSH ACC
	MOV A,#0FFH
DE_1:
	DJNZ ACC,DE_1
	POP ACC
	RET
; SPINT NUM
; INPT ==> ACC OUT ==> ACC B
SPIT_NUM:
	MOV B,A
	ANL A,#0FH
	XCH A,B
	MOV A,#0F0H
	
	RR A
	RR A
	RR A
	RR A
	
	RET
; REG_LOC_BUF & REG_NUM_BUF --> IN
SHOW_NUM_SING:
	PUSH ACC
	
	;first send the address
	MOV A,REG_LOC_BUFF
	LCALL TRAN_ADD
	LCALL SEND_BYTE_TO_SEG
	
	MOV A,REG_NUM_BUFF
	LCALL TRAN_DIG
	LCALL SEND_BYTE_TO_SEG
	

	CLR PIN_STCP
	NOP
	NOP
	SETB PIN_STCP
	
	POP ACC
	RET

; ACC ==> IN
SEND_BYTE_TO_SEG:
	PUSH ADD_R1
	
	MOV R1,#8
SEND_BYTE_TO_SEG_LOP1:
	RLC A
	MOV PIN_DS,C

	CLR  PIN_SHCP
	NOP
	NOP
	SETB  PIN_SHCP
	
	DJNZ R1,SEND_BYTE_TO_SEG_LOP1
	
	
	POP ADD_R1
	RET

; IN ==> ACC
; OUT ==> ACC
TRAN_DIG:
	PUSH DPH
	PUSH DPL
	
	MOV DPTR,#DIG_NUM_SEG
	MOVC A,@A+DPTR
	
	POP DPL
	POP DPH
	RET

; IN ==> ACC
; OUT ==> ACC
TRAN_ADD:
	PUSH DPH
	PUSH DPL
	
	MOV DPTR,#DIG_ADD_SEG
	MOVC A,@A+DPTR
	
	POP DPL
	POP DPH
	RET

;---- 中断 ----
T0_INT:
	PUSH ACC;
	PUSH PSW
	
	MOV A,REG_CNT
	INC A
	MOV REG_CNT,A
	
	CJNE A,#20,T0_END
	
	MOV REG_CNT,#0
	MOV A,REG_SEC
	INC A
	MOV REG_SEC,A
	
	/*
	;DEBUG
	LCALL DELY_DISY
	*/
	
	MOV A,REG_LED_INT
	RR A
	MOV REG_LED_INT,A
	MOV P1,REG_LED_INT

	MOV  TH0, #60;赋初值
	MOV  TL0, #176
	
	
	
T0_END:
	POP PSW
	POP ACC
	RETI

X0_INT:
	LCALL DELY_DISY
	LCALL DELY_DISY
	JB INT0,X0_INT_END
	PUSH ACC
	PUSH PSW
	PUSH B
	
	
	MOV B,#100
	
	MOV A,REG_TIMES
	INC A
	DIV AB
	MOV A,B
	
	MOV REG_TIMES,A
	POP B
	POP PSW
	POP ACC
X0_INT_END:
	RETI
;---- 数据区 ----
DIG_ADD_SEG:
	DB 01H,02H,04H,08H,10H,20H,40H,80H,0FFH
DIG_NUM_SEG:
	DB 0C0H,0F9H,0A4H,0B0H,99H,92H,82H,0F8H,80H,90H 
END